## config/west.yml
```yaml
manifest:
  remotes:
    - name: zmkfirmware
      url-base: https://github.com/zmkfirmware
    - name: bcat
      url-base: https://github.com/bcat
  projects:
    - name: zmk
      remote: bcat
      revision: tri_layer
      import: app/west.yml
  self:
    path: config
```
